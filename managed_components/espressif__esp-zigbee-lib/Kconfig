## managed_components/espressif__esp_rcp_update/Kconfig
```kconfig
menu "OpenThread RCP Update"

    config AUTO_UPDATE_RCP
        bool 'Update RCP automatically'
        default n
        help
            If enabled, the device will store the RCP image in its firmware and
            compare the stored image version with the running RCP image upon boot. The RCP
            will be automatically updated upon version mismatch.

    config CREATE_OTA_IMAGE_WITH_RCP_FW
        bool 'Create the OTA image with rcp for border router'
        default n
        help
            If enabled, an ota image will be generated during building.

    config RCP_SRC_DIR
        depends on AUTO_UPDATE_RCP || CREATE_OTA_IMAGE_WITH_RCP_FW
        string "Source folder containing the RCP firmware"
        default "$ENV{IDF_PATH}/examples/openthread/ot_rcp/build"
        help
            The source folder containing the RCP firmware.

    config RCP_PARTITION_NAME
        depends on AUTO_UPDATE_RCP
        string "Name of RCP storage partition"
        default "rcp_fw"
        help
            The name of RCP storage partition.

endmenu
```

## managed_components/espressif__esp_secure_cert_mgr/Kconfig
```kconfig
menu "ESP Secure Cert Manager"

    config ESP_SECURE_CERT_DS_PERIPHERAL
        bool "Enable DS peripheral support"
        default y
        depends on !IDF_TARGET_ESP32 && !IDF_TARGET_ESP32C2
        help
            Enable the DS peripheral support. Not supported on esp32 and esp32c2.

    config ESP_SECURE_CERT_SUPPORT_LEGACY_FORMATS
        bool "Enable support for legacy formats"
        default n
        help
            This option enables support for the legacy formats along with
            the current format in the esp_secure_cert component.
            The current format is
            cust_flash_tlv
            The legacy formats are as follows:
            cust_flash
            nvs

endmenu # ESP Secure Cert Manager
```

## managed_components/espressif__network_provisioning/Kconfig
```kconfig
menu "Network Provisioning Manager"

    choice NETWORK_PROV_NETWORK_TYPE
        prompt "Network Type"
        default NETWORK_PROV_NETWORK_TYPE_WIFI if ESP_WIFI_ENABLED
        default NETWORK_PROV_NETWORK_TYPE_THREAD if !ESP_WIFI_ENABLE && OPENTHREAD_ENABLED

        config NETWORK_PROV_NETWORK_TYPE_WIFI
            bool "Network Type - Wi-Fi"
            depends on ESP_WIFI_ENABLED

        config NETWORK_PROV_NETWORK_TYPE_THREAD
            bool "Network Type - Thread"
            depends on OPENTHREAD_ENABLED

    endchoice

    config NETWORK_PROV_SCAN_MAX_ENTRIES
        int "Max Network Scan Result Entries"
        default 16
        range 1 255
        help
            This sets the maximum number of entries of network scan results that will be kept by the
            provisioning manager

    config NETWORK_PROV_AUTOSTOP_TIMEOUT
        int "Provisioning auto-stop timeout"
        default 30
        range 5 600
        help
            Time (in seconds) after which the network provisioning manager will auto-stop after connecting to
            a network successfully.

    config NETWORK_PROV_BLE_BONDING
        bool
        prompt "Enable BLE bonding"
        depends on BT_ENABLED
        help
            This option is applicable only when provisioning transport is BLE. Used to enable BLE bonding process
            where the information from the pairing process will be stored on the devices.

    config NETWORK_PROV_BLE_SEC_CONN
        bool
        prompt "Enable BLE Secure connection flag"
        depends on  BT_NIMBLE_ENABLED
        default y
        help
            Used to enable Secure connection support when provisioning transport is BLE.

    config NETWORK_PROV_BLE_FORCE_ENCRYPTION
        bool
        prompt "Force Link Encryption during characteristic Read / Write"
        help
            Used to enforce link encryption when attempting to read / write characteristic

    config NETWORK_PROV_KEEP_BLE_ON_AFTER_PROV
        bool "Keep BT on after provisioning is done"
        depends on BT_ENABLED
        select ESP_PROTOCOMM_KEEP_BLE_ON_AFTER_BLE_STOP

    config NETWORK_PROV_DISCONNECT_AFTER_PROV
        bool "Terminate connection after provisioning is done"
        depends on NETWORK_PROV_KEEP_BLE_ON_AFTER_PROV
        default y
        select ESP_PROTOCOMM_DISCONNECT_AFTER_BLE_STOP

    choice NETWORK_PROV_WIFI_STA_SCAN_METHOD
        bool "Wifi Provisioning Scan Method"
        depends on NETWORK_PROV_NETWORK_TYPE_WIFI
        default NETWORK_PROV_WIFI_STA_ALL_CHANNEL_SCAN
        config NETWORK_PROV_WIFI_STA_ALL_CHANNEL_SCAN
            bool "All Channel Scan"
            help
                    Scan will end after scanning the entire channel. This option is useful in Mesh WiFi Systems.
        config NETWORK_PROV_WIFI_STA_FAST_SCAN
            bool "Fast Scan"
            help
                    Scan will end after an AP matching with the SSID has been detected.
    endchoice
endmenu
```

## managed_components/espressif__network_provisioning/examples/thread_prov/main/Kconfig.projbuild
```kconfig
menu "Example Configuration"

    choice EXAMPLE_PROV_SECURITY_VERSION
        bool "Protocomm security version"
        default EXAMPLE_PROV_SECURITY_VERSION_2
        help
            Network provisioning component offers 3 security versions.
            The example offers a choice between security version 1 and 2.

        config EXAMPLE_PROV_SECURITY_VERSION_1
            bool "Security version 1"
            select ESP_PROTOCOMM_SUPPORT_SECURITY_VERSION_1

        config EXAMPLE_PROV_SECURITY_VERSION_2
            bool "Security version 2"
            select ESP_PROTOCOMM_SUPPORT_SECURITY_VERSION_2
    endchoice

    choice EXAMPLE_PROV_MODE
        bool "Security version 2 mode"
        depends on EXAMPLE_PROV_SECURITY_VERSION_2
        default EXAMPLE_PROV_SEC2_DEV_MODE

        config EXAMPLE_PROV_SEC2_DEV_MODE
            bool "Security version 2 development mode"
            depends on EXAMPLE_PROV_SECURITY_VERSION_2
            help
                This enables the development mode for
                security version 2.
                Please note that this mode is NOT recommended for production purpose.

        config EXAMPLE_PROV_SEC2_PROD_MODE
            bool "Security version 2 production mode"
            depends on EXAMPLE_PROV_SECURITY_VERSION_2
            help
                This enables the production mode for
                security version 2.
    endchoice

    config EXAMPLE_PROV_TRANSPORT
        int
        default 1 if EXAMPLE_PROV_TRANSPORT_BLE

    config EXAMPLE_RESET_PROVISIONED
        bool
        default n
        prompt "Reset provisioned status of the device"
        help
            This erases the NVS to reset provisioned status of the device on every reboot.
            Provisioned status is determined by the Wi-Fi STA configuration, saved on the NVS.

    config EXAMPLE_RESET_PROV_MGR_ON_FAILURE
        bool
        default y
        prompt "Reset provisioned credentials and state machine after session failure"
        help
            Enable reseting provisioned credentials and state machine after session failure.
            This will restart the provisioning service after retries are exhausted.

    config EXAMPLE_PROV_MGR_MAX_RETRY_CNT
        int
        default 5
        prompt "Max retries before reseting provisioning state machine"
        depends on EXAMPLE_RESET_PROV_MGR_ON_FAILURE
        help
            Set the Maximum retry to avoid reconnecting to an inexistent AP or if credentials
            are misconfigured. Provisioned credentials are erased and internal state machine
            is reset after this threshold is reached.

    config EXAMPLE_PROV_SHOW_QR
        bool "Show provisioning QR code"
        default y
        help
            Show the QR code for provisioning.

    config EXAMPLE_REPROVISIONING
        bool "Re-provisioning"
        help
            Enable re-provisioning - allow the device to provision for new credentials
            after previous successful provisioning.

endmenu
```

## managed_components/espressif__rmaker_common/Kconfig
```kconfig
menu "ESP RainMaker Common"

    choice ESP_RMAKER_MQTT_GLUE_LIB
        bool "MQTT Library"
        default ESP_RMAKER_LIB_ESP_MQTT
        help
            MQTT Library to be used

        config ESP_RMAKER_LIB_ESP_MQTT
            bool "ESP-MQTT"
        config ESP_RMAKER_LIB_AWS_IOT
            bool "AWS-IOT"
    endchoice

    config ESP_RMAKER_MQTT_GLUE_LIB
        int
        default 1 if ESP_RMAKER_LIB_ESP_MQTT
        default 2 if ESP_RMAKER_LIB_AWS_IOT

    choice ESP_RMAKER_MQTT_PORT
        bool "MQTT Port"
        default ESP_RMAKER_MQTT_PORT_443
        help
            ESP RainMaker MQTT Broker can be connected to either on Port 8883 or port 443.
            Port 443 is recommended as it is generally not blocked by any firewalls,
            since it is standard HTTPS port.

        config ESP_RMAKER_MQTT_PORT_443
            bool "443"
        config ESP_RMAKER_MQTT_PORT_8883
            bool "8883"
    endchoice

    config ESP_RMAKER_MQTT_PORT
        int
        default 1 if ESP_RMAKER_MQTT_PORT_443
        default 2 if ESP_RMAKER_MQTT_PORT_8883

    config ESP_RMAKER_MQTT_PERSISTENT_SESSION
        bool "Use Persisent MQTT sessions"
        default n
        help
            Use persistent MQTT sessions. This improves reliability as QOS1 messages missed
            out due to some network issue are received after the MQTT reconnects. The broker
            caches messages for a period of upto 1 hour. However, a side-effect of this is that
            messages can be received at unexpected time. Enable this option only if it suits
            your use case. Please read MQTT specs to understand more about persistent sessions
            and the cleanSession flag.

    config ESP_RMAKER_MQTT_SEND_USERNAME
        bool "Send MQTT Username"
        default y
        help
            Send a Username during MQTT Connect. This is generally required only for tracking
            the MQTT client types, platform, SDK, etc. in AWS.

    config ESP_RMAKER_MQTT_PRODUCT_NAME
        string "Product Name"
        depends on ESP_RMAKER_MQTT_SEND_USERNAME
        default "RMDev"
        help
            Approved AWS product name. Please get in touch with your Espressif/AWS representative for more info.

    config ESP_RMAKER_MQTT_PRODUCT_VERSION
        string "Product Version"
        depends on ESP_RMAKER_MQTT_SEND_USERNAME
        default "1x0"
        help
            Approved AWS product version. Please get in touch with your Espressif/AWS representative for more info.

    config ESP_RMAKER_MQTT_PRODUCT_SKU
        string "Product SKU"
        depends on ESP_RMAKER_MQTT_SEND_USERNAME
        default "EX00"
        help
            Product SKU. Please get in touch with your Espressif/AWS representative for more info.

    config ESP_RMAKER_MQTT_USE_CERT_BUNDLE
        bool "Use Certificate Bundle"
        default y
        help
            Use Certificate Bundle for server authentication. Enabling this is recommended to safeguard
            against any changes in the server certificates in future. This has an impact on the binary
            size as well as heap requirement.

    config ESP_RMAKER_MAX_MQTT_SUBSCRIPTIONS
        int "Maximum number of MQTT Subscriptions"
        default 10
        help
            This value controls the maximum number of topics that the device can subscribe to.

    config ESP_RMAKER_MQTT_KEEP_ALIVE_INTERVAL
        int "MQTT Keep Alive Internal"
        default 120
        range 30 1200
        help
            MQTT Keep Alive Interval. Note that it can take upto 1.5x of keep alive interval for a device
            to be reported by offline by the MQTT Broker. Change this only if required.

    choice ESP_RMAKER_NETWORK_PROTOCOL_TYPE
        prompt "ESP RainMaker Network Type"
        default ESP_RMAKER_NETWORK_OVER_WIFI
        help
            Network protocol type over which the ESP RainMaker will run.

        config ESP_RMAKER_NETWORK_OVER_WIFI
            # ESP_WIFI_ENABLED was introduced in IDF v5.0
            depends on IDF_TARGET_ESP32 || IDF_TARGET_ESP32C3 || IDF_TARGET_ESP32S2 || IDF_TARGET_ESP32S3 || ESP_WIFI_ENABLED
            bool "ESP RainMaker over Wi-Fi"

        config ESP_RMAKER_NETWORK_OVER_THREAD
            depends on OPENTHREAD_ENABLED
            bool "ESP RainMaker over Thread"
    endchoice

    config ESP_RMAKER_WORK_QUEUE_TASK_STACK
        int "ESP RainMaker Work Queue Task stack"
        default 4096
        help
            Stack size for the ESP RainMaker Work Queue Task.

    config ESP_RMAKER_WORK_QUEUE_TASK_PRIORITY
        int "ESP RainMaker Work Queue Task priority"
        default 5
        help
            Priority for the ESP RainMaker Work Queue Task. Not recommended to be changed
            unless you really need it.

    config ESP_RMAKER_FACTORY_PARTITION_NAME
        string "ESP RainMaker Factory Partition Name"
        default "fctry"
        help
            Factory NVS Partition name which will have the MQTT connectivity credentials.

    config ESP_RMAKER_FACTORY_NAMESPACE
        string "ESP RainMaker Factory Namespace"
        default "rmaker_creds"
        help
            Namespace in the Factory NVS Partition name which will have the MQTT
            connectivity credentials.

    config ESP_RMAKER_ENCRYPT_FACTORY_PARTITION
        bool "Encrypt Rainmaker Factory partition"
        default false
        depends on NVS_ENCRYPTION
        help
            Enable this option if the factory partition is pre-encrypted before flashing and the encryption keys 
            are flashed in partition with subtype nvs_keys specified by CONFIG_ESP_RMAKER_FACTORY_NVS_KEYS_PARTITION_NAME.
            If an unencrypted factory partition is flashed, the device would not be able to read its data and 
            the partition would be considered empty.
            If nvs encryption keys are not flashed onto device, they would be auto-generated and any previous data 
            in nvs/factory partition would become invalid.

    config ESP_RMAKER_FACTORY_NVS_KEYS_PARTITION_NAME
        string "ESP Rainmaker Factory NVS keys partition label"
        default "nvs_key"
        depends on ESP_RMAKER_ENCRYPT_FACTORY_PARTITION
        help
            Label of the partition of subtype "nvs_keys" used for encrypting/decrypting Rainmaker factory partition.

    config ESP_RMAKER_DEF_TIMEZONE
        string "Default Timezone"
        default "Asia/Shanghai"
        help
            Default Timezone to use. Eg. "Asia/Shanghai", "America/Los_Angeles".
            Check documentation for complete list of valid values. This value
            will be used only if no timezone is set using the C APIs.

    config ESP_RMAKER_SNTP_SERVER_NAME
        string "ESP RainMaker SNTP Server Name"
        default "pool.ntp.org"
        help
            Default SNTP Server which is used for time synchronization.

    config ESP_RMAKER_MAX_COMMANDS
        int "Maximum commands supported for command-response"
        default 10
        help
            Maximum number of commands supported by the command-response framework

endmenu
```
