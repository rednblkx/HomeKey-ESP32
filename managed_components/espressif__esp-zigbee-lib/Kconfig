## managed_components/espressif__esp-zigbee-lib/Kconfig
```kconfig
menu "Zigbee"

    config ZB_ENABLED
        bool "Zigbee Enable"
        default n
        help
            Select this option to enable Zigbee and show the submenu with Zigbee configuration choices.

    choice ZB_DEVICE_TYPE
        prompt "Configure the Zigbee device type"
        depends on ZB_ENABLED
        default ZB_ZCZR
        help
            Configure the Zigbee device type

        config ZB_ZCZR
            bool "Zigbee Coordinator or Router device"
            help
                Select this to enable Zigbee Coordinator or Router.
           
        config ZB_ZED
            bool "Zigbee End Device"
            help
                Select this to enable Zigbee End Device.

        config ZB_ZGPD
            depends on SOC_IEEE802154_SUPPORTED
            bool "Zigbee Green power device"
            help
                Select this to enable Zigbee Green Power Device.

    endchoice

    choice ZB_RADIO_TYPE
        prompt "Configure the Zigbee radio type"
        depends on ZB_ENABLED
        default ZB_RADIO_NATIVE if SOC_IEEE802154_SUPPORTED
        default ZB_RADIO_SPINEL_UART

        config ZB_RADIO_NATIVE
            bool "Native 15.4 radio"
            help
                Select this to use the native 15.4 radio.

        config ZB_RADIO_SPINEL_UART
            bool "Connect to 15.4 radio via Radio Spinel UART"
            select OPENTHREAD_SPINEL_ONLY
            help
                Select this to connect to a Radio Co-Processor via Spinel UART.
    endchoice
    
    menu "Zigbee Example"
        depends on ZB_ENABLED

        config ZB_GP_ENABLED
            depends on (ZB_ZCZR || ZB_ZGPD) && SOC_IEEE802154_SUPPORTED
            bool "Zigbee Green Power enable"
            default y if ZB_ZCZR
            help
                when enable green power, example would support as green power proxy(zczr default enabled), green power combo or just green power device.

    endmenu

    config ZB_DEBUG_MODE
        depends on ZB_ENABLED

        bool "Zigbee Debug Mode"
        default n
        help
            Setting Zigbee stack debug mode.
    
endmenu
```

## managed_components/espressif__esp_diag_data_store/Kconfig
```kconfig
menu "Diagnostics data store"

    choice DIAG_DATA_STORE_RTC_OR_FLASH
        prompt "Diagnostics data store destination"
        default DIAG_DATA_STORE_RTC
        help
            This option configures the place to store diagnostics data: RTC memory or Flash.

            Flash store needs an additional patition table entry.
            NOTE: Diagnostics data partition must be encrypted if Flash Encryption is enabled.

        config DIAG_DATA_STORE_RTC
            bool "RTC memory"

        config DIAG_DATA_STORE_FLASH
            bool "Flash"
            help
                Just a placeholder. This data store type is not supported as of now
    endchoice

    config DIAG_DATA_STORE_REPORTING_WATERMARK_PERCENT
        int "Reporting watermark percentage"
        range 50 90
        default 80
        help
            Data store has facility to post an event when buffer is filled to a configured level.
            This option configures the reporting watermark for critical and non critical data.

    menu "RTC Store"
        depends on DIAG_DATA_STORE_RTC

        config RTC_STORE_DATA_SIZE
            int "RTC store data size"
            default 3072 if IDF_TARGET_ESP32
            default 6144
            range 512 7168
            help
                RTC data store is divided into two parts to store critical and non-critical data.
                This option configures the total size of data store.
                NOTE: On ESP32 devices, from esp-idf release v4.3 and onwards we can use all 8K RTC memory,
                so max range is specified as 7K. On releases before v4.3 we can only access maximum 4K RTC memory and
                RTC store uses few bytes for its operation so default for ESP32 is set to 3K.

        config RTC_STORE_CRITICAL_DATA_SIZE
            int "Maximum size of critical data store"
            default 2048 if IDF_TARGET_ESP32
            default 4096
            range 512 RTC_STORE_DATA_SIZE
            help
                This option configures the size of critical data buffer and remaining is used for
                non critical data buffer.
    endmenu

    menu "Flash Store"
        depends on DIAG_DATA_STORE_FLASH

        config FLASH_STORE_PARTITION_LABEL
            string "Diagnostics data partition name"
            default "diag_data"
            help
                Diagnostics data is stored in this partition
    endmenu

endmenu
```

## managed_components/espressif__esp_diagnostics/Kconfig
```kconfig
menu "Diagnostics"
    choice DIAG_LOG_MSG_ARG_FORMAT
        prompt "Diagnostics log argument format"
        default DIAG_LOG_MSG_ARG_FORMAT_TLV
        help
            For error/warning/event logs, diagnostics module collects program counter, timestamp,
            tag, RO data pointer and log arguments. Log arguments are stored in statically allocated buffer.
            This option configures how to format and store log arguments in buffer.
            Log arguments can be formatted as TLV or complete log string formatted using vsnprintf.

            If "TLV" is selected, buffer contains arguments formatted as TLV.
            Type - 1 byte for the type of argument, please check esp_diag_arg_type_t.
            Length - 1 byte for the size of argument, size is calculated using sizeof operator.
            Value - Size bytes for the value.

            If "STRING" is selected, buffer contains the entire string formatted using vsnprintf.

        config DIAG_LOG_MSG_ARG_FORMAT_TLV
            bool "Format arguments as TLV"
        config DIAG_LOG_MSG_ARG_FORMAT_STRING
            bool "Format arguments as string"
    endchoice

    config DIAG_LOG_MSG_ARG_MAX_SIZE
        int "Maximum size of diagnostics log argument buffer"
        range 32 255
        default 64
        help
            Log arguments are stored in a static allocated buffer.
            This option configures the maximum size of buffer for storing log arguments.

    config DIAG_LOG_DROP_WIFI_LOGS
        bool "Drop Wi-Fi logs"
        default y
        help
            Every Wi-Fi log printed on the console adds three diagnostics logs.
            For some users, Wi-Fi logs may not be that useful.
            By default, diagnostics drops Wi-Fi logs. Set this config option to "n" for recording Wi-Fi logs.

    config DIAG_ENABLE_METRICS
        bool "Enable diagnostics metrics"
        default y
        help
            Diagnostics module supports recording and reporting metrics to cloud.
            This option enables the diagnostics metrics and related functionality.

    config DIAG_METRICS_MAX_COUNT
        depends on DIAG_ENABLE_METRICS
        int "Maximum number of metrics"
        default 20
        help
            This option configures the maximum number of metrics that can be registered.

    config DIAG_ENABLE_HEAP_METRICS
        depends on DIAG_ENABLE_METRICS
        bool "Enable Heap Metrics"
        default y
        help
            Enables the heap memory metrics. This collects free memory, largest free block,
            and minimum free memory for heaps in internal as well as external memory.

    config DIAG_ENABLE_WIFI_METRICS
        depends on DIAG_ENABLE_METRICS
        bool "Enable Wi-Fi Metrics"
        default y
        help
            Enables Wi-Fi metrics and collects Wi-Fi RSSI and minumum ever Wi-Fi RSSI.

    config DIAG_ENABLE_VARIABLES
        bool "Enable diagnostics variables"
        default y
        help
            Variables are similar to metrics but they represent entities where their current value
            is much more important than over a period of time.
            This option enables the diagnostics variables and related functionality

    config DIAG_VARIABLES_MAX_COUNT
        depends on DIAG_ENABLE_VARIABLES
        int "Maximum number of variables"
        default 20
        help
            This option configures the maximum number of variables that can be registered.

    config DIAG_ENABLE_NETWORK_VARIABLES
        depends on DIAG_ENABLE_VARIABLES
        bool "Enable Network variables"
        default y
        help
            Enables the Wi-Fi and IP address variables. Below variables are collected.
            For Wi-Fi: SSID, BSSID, channel, auth mode, connection status, disconnection reason.
            For IP: IPv4 address, netmask, and gateway of the device.

    config DIAG_MORE_NETWORK_VARS
        depends on DIAG_ENABLE_NETWORK_VARIABLES
        bool "Enable More Advanced Network variables"
        default n
        help
            Enable more advanced network variables

    config DIAG_USE_EXTERNAL_LOG_WRAP
        bool "Use external log wrapper"
        default n
        help
            Diagnostics component wraps the esp_log_write and esp_log_writev APIs using `--wrap` gcc option.
            There can be scenario where another component also wants to wrap the logging functions.
            In that case, enable this option and use the data ingestion APIs esp_diag_log_write and esp_diag_log_writev.
endmenu
```

## managed_components/espressif__esp_insights/Kconfig
```kconfig
menu "ESP Insights"

    config ESP_INSIGHTS_ENABLED
        bool "Enable ESP Insights"
        default n

    config ESP_INSIGHTS_DEBUG_ENABLED
        depends on ESP_INSIGHTS_ENABLED
        bool "Enable Insights debug prints"
        default n

    config ESP_INSIGHTS_DEBUG_PRINT_JSON
        depends on ESP_INSIGHTS_DEBUG_ENABLED
        bool "Dump CBOR decoded data instead of hexdump"
        default y
        help
            Print pretty format json data for cbor messages
            If this option is not enabled, hexdump will be presented instead of json data

    config ESP_INSIGHTS_COREDUMP_ENABLE
        bool "Enable core dump summary support"
        default y
        depends on (ESP_COREDUMP_ENABLE_TO_FLASH && ESP_COREDUMP_DATA_FORMAT_ELF) || (ESP32_ENABLE_COREDUMP_TO_FLASH && ESP32_COREDUMP_DATA_FORMAT_ELF)
        help
            This option enables core dump summary functionality in insights.
            In case of crash, insights sends the core dump summary to cloud on next boot.

    choice ESP_INSIGHTS_TRANSPORT
        prompt "Insights default transport"
        default ESP_INSIGHTS_TRANSPORT_HTTPS
        help
            By default insights can send data to cloud using MQTT and HTTPS transports.
            This option configures the default insights transport.
            Insights transport can be overridden using esp_insights_transport_register API.

        config ESP_INSIGHTS_TRANSPORT_MQTT
            bool "MQTT"

        config ESP_INSIGHTS_TRANSPORT_HTTPS
            bool "HTTPS"

    endchoice

    config ESP_INSIGHTS_TRANSPORT_HTTPS_HOST
        depends on ESP_INSIGHTS_TRANSPORT_HTTPS
        string "Insights https host"
        default "https://client.insights.espressif.com"

    config ESP_INSIGHTS_CLOUD_POST_MIN_INTERVAL_SEC
        int "Insights cloud post min interval (sec)"
        default 60
        help
            Minimum interval between two consecutive cloud posts.
            There is a dynamic logic to decide the next timeout when the insights data will be reported.
            It depends on whether the data was sent or not during the previous timeout.
            If the data was sent, the next timeout is doubled and if not, it is halved.

    config ESP_INSIGHTS_CLOUD_POST_MAX_INTERVAL_SEC
        int "Insights cloud post max interval (sec)"
        default 240
        help
            Maximum interval between two consecutive cloud posts.
            There is a dynamic logic to decide the next timeout when the insights data will be reported.
            It depends on whether the data was sent or not during the previous timeout.
            If the data was sent, the next timeout is doubled and if not, it is halved.
endmenu
```
