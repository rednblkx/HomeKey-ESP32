## managed_components/espressif__esp_modem/Kconfig
```kconfig
menu "esp-modem"

    config ESP_MODEM_CMUX_DEFRAGMENT_PAYLOAD
        bool "Defragment CMUX messages internally"
        default y
        help
            If enabled (default), the esp-modem automatically defragments CMUX messages
            to only pass the completed CMUX message to higher layers.
            This is useful for messages in command mode (if they're received fragmented).
            It's not a problem for messages in data mode as the upper layer (PPP protocol)
            defines message boundaries.
            Keep the default to true for most cases (as most devices use simply 1 byte CMUX
            length, as the internal Rx buffer of size >= 256 bytes won't overflow)
            Set to false if your devices uses 2 byte CMUX payload (e.g. A7672S).
            The operation would work without an issue in data mode, but some replies
            in command mode might come fragmented in rare cases so might need to retry
            AT commands.

    config ESP_MODEM_USE_INFLATABLE_BUFFER_IF_NEEDED
        bool "Use inflatable buffer in DCE"
        default n
        help
            If enabled we will process the ongoing AT command by growing the current
            buffer (if we've run out the preconfigured buffer).
            If disabled, we simply report a failure.
            Use this if additional allocation is not a problem and you need to reliably process
            all commands, usually with sporadically longer responses than the configured buffer.
            Could be also used to defragment AT replies in CMUX mode if CMUX_DEFRAGMENT_PAYLOAD=n

    config ESP_MODEM_CMUX_DELAY_AFTER_DLCI_SETUP
        int "Delay in ms to wait before creating another virtual terminal"
        default 0
        help
            Some devices might need a pause before sending SABM command that creates
            virtual terminal. This delay applies only to establishing a CMUX mode.
            The typical reason for failing SABM request without a delay is that
            some devices (SIM800) send MSC requests just after opening a new DLCI.

    config ESP_MODEM_CMUX_USE_SHORT_PAYLOADS_ONLY
        bool "CMUX to support only short payloads (<128 bytes)"
        default n
        help
            If enabled, the CMUX protocol would only use 1 byte size field.
            You can use this option for devices that support only short CMUX payloads
            to make the protocol more robust on noisy environments or when underlying
            transport gets corrupted often (for example by Rx buffer overflows)

    config ESP_MODEM_ADD_CUSTOM_MODULE
        bool "Add support for custom module in C-API"
        default n
        help
            If enabled, we adapt the C-API to create a DCE from a user defined class

    config ESP_MODEM_CUSTOM_MODULE_HEADER
        string "Header file name which defines custom DCE creation"
        depends on ESP_MODEM_ADD_CUSTOM_MODULE
        default "custom_module.hpp"
        help
            Name of the header file in the main component which implements esp_modem_create_custom_dce()
            called from C-API for creating esp_modem_dce object.
            This header provides definition of the custom module with some additional and/or updated commands
            and API. It also defines creation of DCE based on this custom module, typically calling:
            dce_factory::Factory::create_unique_dce_from<CustomModule, DCE*>(dce_config, std::move(dte), netif)
            Please refer to the pppos_client example for more details.

    config ESP_MODEM_C_API_STR_MAX
        int "Size in bytes for response from AT commands returning textual values (C-API)"
        default 128
        help
            Some AT commands returns textual values which C-API copy as c-string to user allocated space,
            it also truncates the output data to this size. Increase this if some AT answers are truncated.

    config ESP_MODEM_URC_HANDLER
        bool "Enable support for adding URC handler"
        default n
        help
            If enabled, APIs to add URC handler are available

    config ESP_MODEM_PPP_ESCAPE_BEFORE_EXIT
        bool "Send escape sequence when switching PPP -> CMD"
        default n
        help
            If enabled, the library sends a PPP escape ("+++" command)
            to switch to command mode. This make switching from PPP to CMD
            mode more robust for some devices (e.g. Quectel), but might cause
            trouble for other devices (e.g. SIMCOM).

    config ESP_MODEM_ADD_DEBUG_LOGS
        bool "Add UART Tx/Rx logs"
        default n
        help
            If enabled, the library dumps all transmitted and received data.
            This option is only used for debugging.

endmenu
```

## managed_components/espressif__esp_modem/examples/ap_to_pppos/main/Kconfig.projbuild
```kconfig
menu "Example Configuration"

    config ESP_WIFI_SSID
        string "WiFi SSID"
        default "myssid"
        help
            SSID (network name) for the example to connect to.

    config ESP_WIFI_PASSWORD
        string "WiFi Password"
        default "mypassword"
        help
            WiFi password (WPA or WPA2) for the example to use.

    config ESP_WIFI_CHANNEL
        int "WiFi Channel"
        range 1 13
        default 1
        help
            WiFi channel (network channel) for the example to use.

    config ESP_MAX_STA_CONN
        int "Maximal STA connections"
        default 4
        help
            Max number of the STA connects to AP.

    config EXAMPLE_MODEM_PPP_APN
        string "Set MODEM APN"
        default "internet"
        help
            Set APN (Access Point Name), a logical name to choose data network

    config EXAMPLE_NEED_SIM_PIN
        bool "SIM PIN needed"
        default n
        help
            Enable to set SIM PIN before starting the example

    config EXAMPLE_SIM_PIN
        string "Set SIM PIN"
        default "1234"
        depends on EXAMPLE_NEED_SIM_PIN
        help
            Pin to unlock the SIM

    config EXAMPLE_USE_MINIMAL_DCE
        bool "Use minimal network DCE"
        default n
        help
            Define a specific network only DCE class and
            create it using DCE factory

endmenu
```

## managed_components/espressif__esp_modem/examples/modem_psm/main/Kconfig.projbuild
```kconfig
menu "Example Configuration"

    choice EXAMPLE_MODEM_DEVICE
        prompt "Choose supported modem device (DCE)"
        default EXAMPLE_MODEM_DEVICE_SIM7080
        help
            Select modem device connected to the ESP DTE.
        config EXAMPLE_MODEM_DEVICE_SIM7070
            bool "SIM7070"
            help
                SIM7070 is Multi-Band CAT M and NB IoT module.
        config EXAMPLE_MODEM_DEVICE_SIM7080
            bool "SIM7080"
            help
                SIM7080 is Multi-Band CAT M and NB IoT module.
    endchoice

    menu "UART Configuration"
        config EXAMPLE_MODEM_UART_TX_PIN
            int "TXD Pin Number"
            default 4
            range 0 56
            help
                Pin number of UART TX.

        config EXAMPLE_MODEM_UART_RX_PIN
            int "RXD Pin Number"
            default 5
            range 0 56
            help
                Pin number of UART RX.

        config EXAMPLE_MODEM_UART_EVENT_TASK_STACK_SIZE
            int "UART Event Task Stack Size"
            range 2000 6000
            default 4096
            help
                Stack size of UART event task.

        config EXAMPLE_MODEM_UART_EVENT_TASK_PRIORITY
            int "UART Event Task Priority"
            range 3 22
            default 5
            help
                Priority of UART event task.

        config EXAMPLE_MODEM_UART_EVENT_QUEUE_SIZE
            int "UART Event Queue Size"
            range 10 40
            default 30
            help
                Length of UART event queue.

        config EXAMPLE_MODEM_UART_TX_BUFFER_SIZE
            int "UART TX Buffer Size"
            range 256 2048
            default 512
            help
                Buffer size of UART TX buffer.

        config EXAMPLE_MODEM_UART_RX_BUFFER_SIZE
            int "UART RX Buffer Size"
            range 256 2048
            default 1024
            help
                Buffer size of UART RX buffer.
    endmenu

    config EXAMPLE_MODEM_PWRKEY_PIN
        int "PWRKEY Pin Number"
        default 18
        range 0 56
        help
            Pin number connected to modem's power key pin.

    config EXAMPLE_MODEM_STATUS_PIN
        int "STATUS Pin Number"
        default 19
        range 0 56
        help
            Pin number connected to modem's status pin.

    config EXAMPLE_MODEM_LIGHT_SLEEP_DURATION
        int "Light Sleep Duration"
        default 10
        range 0 15000
        help
            Duration in seconds, of which the esp32 goes into light sleep while the modem is awake.

    config EXAMPLE_MODEM_PPP_APN
        string "Set MODEM APN"
        default "internet"
        help
            Set APN (Access Point Name), a logical name to choose data network

    config EXAMPLE_MODEM_T3412_PERIODIC_TAU
        string "T3412 Requester Periodic TAU"
        default "00000100"
        help
            T3412 timer, i.e the duration of one awake and sleep cycle of the modem in PSM.

    config EXAMPLE_MODEM_T3324_ACTIVE_TIME
        string "T3324 Requester Active Time"
        default "00000001"
        help
            T3324 timer, i.e the duration for which the modem stays PSM.

endmenu
```

## managed_components/espressif__esp_modem/examples/modem_tcp_client/main/Kconfig.projbuild
```kconfig
menu "Example Configuration"

    config EXAMPLE_CUSTOM_TCP_TRANSPORT
        bool "Custom TCP transport"
        help
            Use custom TCP transport to connect to MQTT broker

    choice EXAMPLE_MODEM_DEVICE
        prompt "Choose supported modem device (DCE)"
        default EXAMPLE_MODEM_DEVICE_BG96
        help
            Select modem device connected to the ESP DTE.
        config EXAMPLE_MODEM_DEVICE_BG96
            bool "BG96"
            help
                Quectel BG96 is a series of LTE Cat M1/Cat NB1/EGPRS module.
        config EXAMPLE_MODEM_DEVICE_SIM7600
            bool "SIM7600"
            help
                SIM7600 is Multi-Band LTE-TDD/LTE-FDD/HSPA+ and GSM/GPRS/EDGE module
    endchoice

    config EXAMPLE_MODEM_APN
        string "Set MODEM APN"
        default "internet"
        help
            Set APN (Access Point Name), a logical name to choose data network

    menu "UART Configuration"
        config EXAMPLE_MODEM_UART_TX_PIN
            int "TXD Pin Number"
            default 25
            range 0 56
            help
                Pin number of UART TX.

        config EXAMPLE_MODEM_UART_RX_PIN
            int "RXD Pin Number"
            default 26
            range 0 56
            help
                Pin number of UART RX.

        config EXAMPLE_MODEM_UART_RTS_PIN
            int "RTS Pin Number"
            default 27
            range 0 56
            help
                Pin number of UART RTS.

        config EXAMPLE_MODEM_UART_CTS_PIN
            int "CTS Pin Number"
            default 23
            range 0 56
            help
                Pin number of UART CTS.

        config EXAMPLE_MODEM_UART_EVENT_TASK_STACK_SIZE
            int "UART Event Task Stack Size"
            range 2000 6000
            default 2048
            help
                Stack size of UART event task.

        config EXAMPLE_MODEM_UART_EVENT_TASK_PRIORITY
            int "UART Event Task Priority"
            range 3 22
            default 5
            help
                Priority of UART event task.

        config EXAMPLE_MODEM_UART_EVENT_QUEUE_SIZE
            int "UART Event Queue Size"
            range 10 40
            default 30
            help
                Length of UART event queue.

        config EXAMPLE_MODEM_UART_PATTERN_QUEUE_SIZE
            int "UART Pattern Queue Size"
            range 10 40
            default 20
            help
                Length of UART pattern queue.

        config EXAMPLE_MODEM_UART_TX_BUFFER_SIZE
            int "UART TX Buffer Size"
            range 256 2048
            default 512
            help
                Buffer size of UART TX buffer.

        config EXAMPLE_MODEM_UART_RX_BUFFER_SIZE
            int "UART RX Buffer Size"
            range 256 2048
            default 1024
            help
                Buffer size of UART RX buffer.
    endmenu

endmenu
```
